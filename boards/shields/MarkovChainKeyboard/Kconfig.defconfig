## boards/shields/MarkovChainKeyboard/Kconfig.defconfig
```kconfig
if SHIELD_MarkovChainKeyboard

config ZMK_KEYBOARD_NAME
    default "MarkovChainKeyboard"

endif
```

## boards/shields/MarkovChainKeyboard/Kconfig.shield
```kconfig
config MarkovChainKeyboard
    def_bool $(shields_list_contains,MarkovChainKeyboard)
```
